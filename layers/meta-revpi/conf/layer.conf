## layers/meta-revpi/conf/layer.conf
```bitbake
BBPATH .= ":${LAYERDIR}"

BBFILES += "${LAYERDIR}/recipes-*/*/*.bb \
            ${LAYERDIR}/recipes-*/*/*.bbappend"

BBFILE_COLLECTIONS += "meta-revpi"
BBFILE_PATTERN_meta-revpi := "^${LAYERDIR}/"
BBFILE_PRIORITY_meta-revpi = "1337"

LAYERSERIES_COMPAT_meta-revpi = "kirkstone"

# we do not add the following overlays for the linux-kunbus kernel
KERNEL_DEVICETREE:remove:revpi = "overlays/ds2482.dtbo"
KERNEL_DEVICETREE:remove:revpi = "overlays/neuron-spi-new.dtbo"
KERNEL_DEVICETREE:remove:revpi = "overlays/neuron-spi.dtbo"
KERNEL_DEVICETREE:remove:revpi = "overlays/neuronee.dtbo"
KERNEL_DEVICETREE:remove:revpi = "overlays/unipiee.dtbo"
KERNEL_DEVICETREE:remove:revpi = "overlays/waveshare-sim7600.dtbo"

# the Revolution Pi boards are on an older kernel release which does not have the following overlays
KERNEL_DEVICETREE:remove:revpi = "overlays/i2c0.dtbo"
KERNEL_DEVICETREE:remove:revpi = "overlays/i2c1.dtbo"
KERNEL_DEVICETREE:remove:revpi = "overlays/tpm-slb9670.dtbo"
KERNEL_DEVICETREE:remove:revpi = "overlays/tpm-slb9670-tis-spi.dtbo"
KERNEL_DEVICETREE:remove:revpi = "overlays/spi3-1cs.dtbo"
KERNEL_DEVICETREE:remove:revpi = "overlays/spi3-2cs.dtbo"
KERNEL_DEVICETREE:remove:revpi = "overlays/spi4-1cs.dtbo"
KERNEL_DEVICETREE:remove:revpi = "overlays/spi4-2cs.dtbo"
KERNEL_DEVICETREE:remove:revpi = "overlays/spi5-1cs.dtbo"
KERNEL_DEVICETREE:remove:revpi = "overlays/spi5-2cs.dtbo"
KERNEL_DEVICETREE:remove:revpi = "overlays/spi6-1cs.dtbo"
KERNEL_DEVICETREE:remove:revpi = "overlays/spi6-2cs.dtbo"
KERNEL_DEVICETREE:remove:revpi = "overlays/gpio-ir-tx.dtbo"
KERNEL_DEVICETREE:remove:revpi = "overlays/uart2.dtbo"
KERNEL_DEVICETREE:remove:revpi = "overlays/uart3.dtbo"
KERNEL_DEVICETREE:remove:revpi = "overlays/uart4.dtbo"
KERNEL_DEVICETREE:remove:revpi = "overlays/uart5.dtbo"
KERNEL_DEVICETREE:remove:revpi = "overlays/adafruit18.dtbo"
KERNEL_DEVICETREE:remove:revpi = "overlays/allo-boss2-dac-audio.dtbo"
KERNEL_DEVICETREE:remove:revpi = "overlays/cma.dtbo"
KERNEL_DEVICETREE:remove:revpi = "overlays/fsm-demo.dtbo \
    overlays/ghost-amp.dtbo"
KERNEL_DEVICETREE:remove:revpi = "overlays/highperi.dtbo"
KERNEL_DEVICETREE:remove:revpi = "overlays/imx219.dtbo \
    overlays/imx290.dtbo \
    overlays/imx290_327.dtbo \
    overlays/imx378.dtbo \
    overlays/imx477.dtbo \
    overlays/imx519.dtbo \
    overlays/iqaudio-codec.dtbo"
KERNEL_DEVICETREE:remove:revpi = "overlays/irs1125.dtbo \
    overlays/jedec-spi-nor.dtbo \
    overlays/justboom-both.dtbo \
"
KERNEL_DEVICETREE:remove:revpi = "overlays/maxtherm.dtbo \
    overlays/mbed-dac.dtbo \
"
KERNEL_DEVICETREE:remove:revpi = "overlays/mcp251xfd.dtbo"
KERNEL_DEVICETREE:remove:revpi = "overlays/ov7251.dtbo \
    overlays/ov9281.dtbo \
    overlays/overlay_map.dtbo \
"
KERNEL_DEVICETREE:remove:revpi = "overlays/pca953x.dtbo"
KERNEL_DEVICETREE:remove:revpi = "overlays/pifacedigital.dtbo \
    overlays/pifi-40.dtbo \
    overlays/piglow.dtbo"
KERNEL_DEVICETREE:remove:revpi = "overlays/rpivid-v4l2.dtbo"
KERNEL_DEVICETREE:remove:revpi = "overlays/pwn-ir-tx.dtbo"
KERNEL_DEVICETREE:remove:revpi = "overlays/sainsmart18.dtbo"
KERNEL_DEVICETREE:remove:revpi = "overlays/sc16is752-i2c.dtbo \
    overlays/sc16is752-spi0.dtbo"
KERNEL_DEVICETREE:remove:revpi = "overlays/sh1106-spi.dtbo"
KERNEL_DEVICETREE:remove:revpi = "overlays/ssd1306.dtbo \
    overlays/ssd1306-spi.dtbo \
    overlays/ssd1351-spi.dtbo \
    overlays/superaudioboard.dtbo \
    overlays/sx150x.dtbo \
    overlays/tc358743-audio.dtbo \
    overlays/tc358743.dtbo"
KERNEL_DEVICETREE:remove:revpi = "overlays/spi0-1cs.dtbo \
    overlays/spi0-2cs.dtbo \"
KERNEL_DEVICETREE:remove:revpi = "overlays/upstream-pi4.dtbo"
KERNEL_DEVICETREE:remove:revpi = "overlays/vc4-kms-v3d-pi4.dtbo"
KERNEL_DEVICETREE:remove:revpi = "overlays/wm8960-soundcard.dtbo"
KERNEL_DEVICETREE:remove:revpi = "overlays/audioinjector-isolated-soundcard.dtbo \
    overlays/audioinjector-ultra.dtbo \
    overlays/audiosense-pi.dtbo \
"
KERNEL_DEVICETREE:remove:revpi = "overlays/hdmi-backlight-hwhack-gpio.dtbo"
KERNEL_DEVICETREE:remove:revpi = "overlays/hifiberry-dacplushd.dtbo"
KERNEL_DEVICETREE:remove:revpi = "overlays/merus-amp.dtbo"
KERNEL_DEVICETREE:remove:revpi = "overlays/overlay_map.dtb"
KERNEL_DEVICETREE:remove:revpi = "overlays/2xmcp2517fd.dtbo"
KERNEL_DEVICETREE:remove:revpi = "overlays/rpi-poe-plus.dtbo"
KERNEL_DEVICETREE:remove:revpi = "overlays/vc4-kms-dsi-7inch.dtbo"
KERNEL_DEVICETREE:remove:revpi = "overlays/edt-ft5406.dtbo"
KERNEL_DEVICETREE:remove:revpi = "overlays/fbtft.dtbo"
KERNEL_DEVICETREE:remove:revpi = "bcm2708-rpi-b-rev1.dtb"
KERNEL_DEVICETREE:remove:revpi = "bcm2711-rpi-400.dtb"
KERNEL_DEVICETREE:remove:revpi = "bcm2711-rpi-cm4.dtb"
KERNEL_DEVICETREE:remove:revpi = "overlays/vc4-fkms-v3d-pi4.dtbo"

# the following overlays were added only for linux-raspberrypi so let's remove them for Revolution Pi boards which use linux-kunbus
KERNEL_DEVICETREE:remove:revpi = "overlays/hyperpixel4-pi3.dtbo overlays/hyperpixel4-pi4.dtbo overlays/hyperpixel4-square-pi3.dtbo overlays/hyperpixel4-square-pi4.dtbo"

# We use udev rules to create serial device aliases
SERIAL_CONSOLES = "115200;serial0"

KERNEL_FEATURES:remove:revpi-core-3 = "cfg/fs/vfat.scc"
```
